## main/Kconfig
```kconfig
# Kconfig file for app configuration

menu "Application configuration"

    config APPLICATION_API_KEY
        string
        prompt "Open Weather Map API key"
        default "91a6a0c18796114d8b407b7fdb8fcbf9"

    config APPLICATION_CONTINENT
            string
            prompt "Continent"
            default "Europe"

    config APPLICATION_CITY
            string
            prompt "City"
            default "Berlin"

    config APPLICATION_LANGUAGE
            string
            prompt "Language for display information (two characters)"
            default "EN"

    config APPLICATION_WEATHER_REFRESH_FREQUENCY
        int
        prompt "Time interval (in minutes) for weather refresh"
        default 10

    config APPLICATION_TIMEZONE_POSIX
        string
        prompt "POSIX timezone string"
        default "CET-1CEST,M3.5.0,M10.5.0/3"
        help
            POSIX timezone string used for local time conversion after SNTP sync.
            Example for Berlin: CET-1CEST,M3.5.0,M10.5.0/3

endmenu
```
